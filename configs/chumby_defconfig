## configs/chumby_defconfig
```kconfig
# architecture
BR2_arm=y
BR2_arm926t=y

# system
BR2_TARGET_GENERIC_GETTY_PORT="ttyAMA0"

# kernel
BR2_LINUX_KERNEL=y
BR2_KERNEL_HEADERS_LATEST=y
BR2_PACKAGE_HOST_LINUX_HEADERS_CUSTOM_5_9=y
BR2_LINUX_KERNEL_DTS_SUPPORT=y
BR2_LINUX_KERNEL_INTREE_DTS_NAME="imx23-chumby"
BR2_LINUX_KERNEL_USE_CUSTOM_CONFIG=y
BR2_LINUX_KERNEL_CUSTOM_CONFIG_FILE="board/chumby/chumby.kernel.config"
BR2_LINUX_KERNEL_PATCH="board/chumby/0001-chumby-falconwing-1.00.patch"
```
